#define BLYNK_PRINT Serial
#include <ESP8266WiFi.h>
#include <BlynkSimpleEsp8266.h>
#include <DHT.h>
#include <Adafruit_Sensor.h>
#include <Adafruit_BMP280.h>
#include <Wire.h>
#include <Adafruit_GFX.h>
#include <Adafruit_SSD1306.h>

#define SEALEVELPRESSURE_HPA (1013.25)
#define SCREEN_WIDTH 128 
#define SCREEN_HEIGHT 64 
#define OLED_RESET    -1 

Adafruit_SSD1306 display(SCREEN_WIDTH, SCREEN_HEIGHT, &Wire, OLED_RESET);
Adafruit_BMP280 bmp;

char auth[] = "pzJxV2urte3Epw-27dtw6p4zHZ4HyfAw";
char ssid[] = "TP-LINK_41EEBC";
char pass[] = "LINA@2018@";

DHT dht(D3, DHT11);
BlynkTimer timer;

#define rain A0
#define soilMoisture D1

float hi, humidity, temp, rainValue, pressureValue, altitude, soilMoistureValue;



const unsigned char MarilynMonroe [] PROGMEM = {  
 0x00, 0x00, 0x00, 0x00, 0x00, 0x00, 0x00, 0x00, 0x00, 0x00, 0x00, 0x00, 0x00, 0x00, 0x00, 0x00, 
 0x00, 0x00, 0x00, 0x00, 0x00, 0x00, 0x00, 0x00, 0x00, 0x00, 0x00, 0x00, 0x00, 0x00, 0x00, 0x00, 
 0x00, 0x00, 0x00, 0x00, 0x00, 0x00, 0x00, 0x00, 0x00, 0x00, 0x00, 0x00, 0x00, 0x00, 0x00, 0x00, 
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 0x00, 0x00, 0x00, 0x00, 0x00, 0x00, 0x00, 0x00, 0x00, 0x00, 0x00, 0x00, 0x00, 0x00, 0x00, 0x00
};

void setup() {
  Serial.begin(9600);
  
  if (!bmp.begin(0x76)) { 
    Serial.println("Could not find a valid BMP280 sensor, check wiring!");
    while (1);
  }

  
  if(!display.begin(SSD1306_SWITCHCAPVCC, 0x3C)) { 
    Serial.println(F("SSD1306 allocation failed"));
    for(;;);
  }
  display.clearDisplay();
  display.display();


  
  display.drawBitmap(0, 0,  MarilynMonroe, 128, 64, WHITE);
  display.display();
  delay(1000);
  display.clearDisplay();
  
  Blynk.begin(auth, ssid, pass, "blynk.cloud", 80);
  dht.begin();

  timer.setInterval(100L, DHT11sensor);
  timer.setInterval(100L, rainSensor);
  timer.setInterval(100L, pressure);
  timer.setInterval(100L, soilMoistureSensor); 
  timer.setInterval(1000L, updateOLED);  
}

void DHT11sensor() {
  humidity = dht.readHumidity();
  temp = dht.readTemperature();

  if (isnan(humidity) || isnan(temp)) {
    Serial.println("Failed to read from DHT sensor!");
    return;
  }

  
  hi = -42.379 + 2.04901523 * temp 
        + 10.14333127 * humidity
        - 0.22475541 * temp * humidity
        - 6.83783 * pow(10, -3) * pow(temp, 2)
        - 5.481717 * pow(10, -2) * pow(humidity, 2)
        + 1.22874 * pow(10, -3) * pow(temp, 2) * humidity
        + 8.5282 * pow(10, -4) * temp * pow(humidity, 2)
        - 1.99 * pow(10, -6) * pow(temp, 2) * pow(humidity, 2);

  hi = (hi - 32) * 5.0 / 9.0;

  Blynk.virtualWrite(V0, hi);
  Blynk.virtualWrite(V1, humidity);
  Blynk.virtualWrite(V5, temp);
}

void rainSensor() {
  int value = analogRead(rain);
  rainValue = map(value, 0, 1024, 0, 100);
  Blynk.virtualWrite(V2, rainValue);
}

void pressure() {
  pressureValue = ( bmp.readPressure() / 100.0F ) +417;
  altitude = bmp.readAltitude(SEALEVELPRESSURE_HPA);

  
  Blynk.virtualWrite(V3, pressureValue);
  Blynk.virtualWrite(V6, altitude * pow(10,-1));
}


void soilMoistureSensor() {
  int value = analogRead(soilMoisture);
  soilMoistureValue = map(value, 0, 1024, 0, 100) - 100;
  Blynk.virtualWrite(V4, soilMoistureValue - 100);
}


void updateOLED() {
  display.clearDisplay();

  display.setTextSize(1);
  display.setTextColor(SSD1306_WHITE);
  display.setCursor(0, 0);

  display.println("Developed by: ");
  display.print("Temperature: "); display.print(temp); display.println(" C");
  display.print("Humidity: "); display.print(humidity); display.println(" %");
  display.print("Pressure: "); display.print(pressureValue); display.println(" hPa");
  display.print("Heat Index: "); display.print(hi); display.println(" C");
  display.print("Rain    : "); display.print(rainValue); display.println(" %");
  display.print("Altitude: "); display.print(altitude * pow(10,-1)); display.println(" m");
  display.print("Soil Moisture: "); display.print(soilMoistureValue); display.println(" %");

  display.display();
  display.startscrollright(0x00, 0x00);
  delay(3000);
}

void loop() {
  Blynk.run();
  timer.run();
}
